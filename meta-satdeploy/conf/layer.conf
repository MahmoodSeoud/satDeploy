## meta-satdeploy/conf/layer.conf
```bitbake
# Layer configuration for meta-satdeploy
BBPATH .= ":${LAYERDIR}"

BBFILES += "${LAYERDIR}/recipes-*/*/*.bb"

BBFILE_COLLECTIONS += "meta-satdeploy"
BBFILE_PATTERN_meta-satdeploy = "^${LAYERDIR}/"
BBFILE_PRIORITY_meta-satdeploy = "10"

LAYERDEPENDS_meta-satdeploy = "core"
LAYERSERIES_COMPAT_meta-satdeploy = "kirkstone scarthgap"
```
